## Kconfig
```kconfig
comment "Extra drivers"
rsource "drivers/*/Kconfig"

#comment "Extra subsystems"
#rsource "subsys/*/Kconfig"

#comment "Extra libraries"
#rsource "lib/*/Kconfig"
```

## drivers/adc_values/Kconfig
```kconfig
# Configuration file for ADC values driver

menuconfig ADC_VALUES
	bool "ADC values driver"
	default y
	depends on DT_HAS_ADC_VALUES_ENABLED
	help
	  Enable support ADC values polling.

if ADC_VALUES

module = ADC_VALUES
module-str = adc_vals
source "subsys/logging/Kconfig.template.log_config"

config ADC_VALUES_INIT_PRIORITY
	int "Driver initialization priority"
	default 90
	help
	  System initialization priority drivers.

config ADC_VALUES_MAX_CHANNELS
        int "Maximum number of channels"
        default 32
        help
          How many channels can be configured per device.

config ADC_VALUES_SHELL
	bool "ADC values shell commands"
	depends on SHELL
	default n
	help
	  Enables shell commands to debug ADC values poller.

endif # ADC_VALUES
```

## drivers/condition_monitor/Kconfig
```kconfig
# Configuration file for condition monitor driver

menuconfig CONDITION_MONITOR
	bool "Condition monitor driver"
	default y
	depends on DT_HAS_CONDITION_MONITOR_ENABLED
	help
	  Enable condition monitoring support.

if CONDITION_MONITOR

module = CONDITION_MONITOR
module-str = cond_mon
source "subsys/logging/Kconfig.template.log_config"

config CONDITION_MONITOR_INIT_PRIORITY
	int "Driver initialization priority"
	default 90
	help
	  System initialization priority drivers.

endif # CONDITION_MONITOR
```

## drivers/i2c_config_switch/Kconfig
```kconfig
menuconfig I2C_CONFIG_SWITCH
	bool "I2C config switch"
	default y
	depends on DT_HAS_I2C_CONFIG_SWITCH_ENABLED
	help
	  This driver is designed to switch I2C bus target mode on and off
	  within power sequencer pipeline via value API.

if I2C_CONFIG_SWITCH

module = I2C_CONFIG_SWITCH
module-str = I2C config switch
source "subsys/logging/Kconfig.template.log_config"

config I2C_CONFIG_SWITCH_INIT_PRIORITY
	int "Driver initialization priority"
	default 90
	help
	  System initialization priority for I2C config switch drivers.

endif # I2C_CONFIG_SWITCH
```

## drivers/i2c_device_configurator/Kconfig
```kconfig
menuconfig I2C_DEVICE_CONFIGURATOR
	bool "I2C device configurator driver"
	default y
	depends on DT_HAS_I2C_DEVICE_CONFIGURATOR_ENABLED
	depends on I2C
	help
	  I2C device configurator writes data specified in write-data DTS property to I2C device
	  on positive transition of REGEXT_STATE value API id, e.g. in power sequencer pipeline.

if I2C_DEVICE_CONFIGURATOR

module = I2C_DEVICE_CONFIGURATOR
module-str = i2c-device-configurator
source "subsys/logging/Kconfig.template.log_config"

config I2C_DEVICE_CONFIGURATOR_INIT_PRIORITY
	int "Driver initialization priority"
	default 90
	help
	  System initialization priority for I2C device configurator drivers.

endif #I2C_DEVICE_CONFIGURATOR
```

## drivers/power_graph/Kconfig
```kconfig
menuconfig POWER_GRAPH
	bool "Power graph"
	default y
	depends on DT_HAS_POWER_GRAPH_ENABLED
	depends on REGULATOR_EXTENDED
	help
	  Enable the driver for power graphs

if POWER_GRAPH

module = POWER_GRAPH
module-str = power-graph
source "subsys/logging/Kconfig.template.log_config"

config POWER_GRAPH_NUM_DEVICES
	int "Maximum number of controlled devices"
	default 64
	help
	  Set the maximum number of devices to switch.

config POWER_GRAPH_NUM_STAGES
	int "Maximum number of stages to switch"
	default 64
	help
	  Set the maximum number of stages to switch.

config POWER_GRAPH_NUM_STATES
	int "Maximum number of states to switch"
	default 4
	help
	  Set the maximum number of states to switch.

config POWER_GRAPH_FAULT_LOG
	int "Fault log depth"
	default 3
	help
	  The number of last logged faults.

	  Set to 0 to disable fault log.

config POWER_GRAPH_INIT_PRIORITY
	int "Init priority"
	default 75
	help
	  Device driver initialization priority

config POWER_GRAPH_SHELL
	bool "Shell commands"
	depends on SHELL
	help
	  Enable extra shell commands for testing.

endif # POWER_GRAPH
```

## drivers/regulator_extended/Kconfig
```kconfig
menuconfig REGULATOR_EXTENDED
	bool "Extended GPIO-controlled regulators"
	default y
	depends on DT_HAS_REGULATOR_EXTENDED_ENABLED
	depends on GPIO
	help
	  Enable the driver for GPIO-controlled regulators

if REGULATOR_EXTENDED

module = REGULATOR_EXTENDED
module-str = regulator-extended
source "subsys/logging/Kconfig.template.log_config"

config REGULATOR_EXTENDED_INIT_PRIORITY
	int "Init priority"
	default 75
	help
	  Device driver initialization priority

config REGULATOR_EXTENDED_MONITOR_PGOODS
	bool "Monitor power good signals"
	default y
	help
	  Enable continuous monitoring for pgood signals when regulator is
	  enabled and/or disabled.

	  When regulator enabled this allows handle power failure cases
	  like a short circuits to prevent hardware damages.

	  When regulator disabled this potentially allows handle power
	  conflict cases when multiple sources may be enabled simultaneously.

config REGULATOR_EXTENDED_SIMULATE_FAULTS
	bool "Support for simulated faults"
	default n
	help
	  Enables fault simulation by setting pgood for testing purposes.

config REGULATOR_EXTENDED_SHELL
	bool "Shell commands"
	depends on SHELL
	help
	  Enable extra shell commands for testing.

endif # REGULATOR_EXTENDED
```

## drivers/value_calc/Kconfig
```kconfig
# Configuration file for value calculator driver

menuconfig VALUE_CALC
	bool "Value calc driver"
	default y
	depends on DT_HAS_VALUE_CALC_ENABLED
	help
	  Enable calculated values support.

if VALUE_CALC

module = VALUE_CALC
module-str = calc
source "subsys/logging/Kconfig.template.log_config"

config VALUE_CALC_INIT_PRIORITY
	int "Driver initialization priority"
	default 95
	help
	  System initialization priority for calculated value drivers.

config VALUE_CALC_MAX_RESULTS
	int "Maximum number of result values"
	default 32
	help
	  How many result values can be used per device.

config VALUE_CALC_SHELL
	bool "Shell command support"
	select FIXED_POINT
	help
	  Enables shell commands to enable/disable calculations and show results.

endif # VALUE_CALC
```

## drivers/value_filter/Kconfig
```kconfig
# Configuration file for value filter driver

menuconfig VALUE_FILTER
	bool "Unified value filter driver"
	default y
	depends on DT_HAS_VALUE_FILTER_ENABLED
	help
	  Enable unified value filter support.

if VALUE_FILTER

module = VALUE_FILTER
module-str = filter
source "subsys/logging/Kconfig.template.log_config"

config VALUE_FILTER_INIT_PRIORITY
	int "Driver initialization priority"
	default 95
	help
	  System initialization priority for value filter drivers.

config VALUE_FILTER_MAX_VALUES
	int "Maximum number of values"
	default 32
	help
	  How many values can be configured per device.

config VALUE_FILTER_SETTINGS
	bool "Use settings to store parameters"
	default y
	depends on SETTINGS
	select SETTINGS_INIT
	help
	  Enable storing filter parameters in settings

config VALUE_FILTER_SHELL
	bool "Value filter shell command"
	depends on SHELL
	select FIXED_POINT
	help
	  Enable value filter shell command for testing.

endif # VALUE_FILTER
```

## drivers/value_minmax/Kconfig
```kconfig
# Configuration file for value min/max driver

menuconfig MINMAX
	bool "Value min/max driver"
	default y
	depends on DT_HAS_VALUE_MINMAX_ENABLED
	help
	  Enable value min/max support.

if MINMAX

module = MINMAX
module-str = minmax
source "subsys/logging/Kconfig.template.log_config"

config MINMAX_INIT_PRIORITY
	int "Driver initialization priority"
	default 95
	help
	  System initialization priority for value min/max drivers.

config MINMAX_MAX_VALUES
	int "Maximum number of values"
	default 32
	help
	  How many values can be configured per device.

endif # MINMAX
```

## drivers/value_mix/Kconfig
```kconfig
# Configuration file for value mixer driver

menuconfig VALUE_MIX
	bool "Value mixer driver"
	default y
	depends on DT_HAS_VALUE_MIX_ENABLED
	help
	  Enable value mixer support.

if VALUE_MIX

module = VALUE_MIX
module-str = mix
source "subsys/logging/Kconfig.template.log_config"

config VALUE_MIX_INIT_PRIORITY
	int "Driver initialization priority"
	default 95
	help
	  System initialization priority for value mixer drivers.

config VALUE_MIX_SETTINGS
	bool "Use settings to store mixer weights"
	default y
	depends on SETTINGS
	select SETTINGS_INIT
	help
	  Enable storing mixer weights in settings

config VALUE_MIX_SHELL
	bool "Value mixer shell command"
	depends on SHELL
	select FIXED_POINT
	help
	  Enable value mixer shell commands

endif # VALUE_MIX
```

## drivers/value_params/Kconfig
```kconfig
# Configuration file for value parameters driver

menuconfig VALUE_PARAMS
	bool "Value params driver"
	default y
	depends on DT_HAS_VALUE_PARAMS_ENABLED
	help
	  Enable value parameters support.

if VALUE_PARAMS

module = VALUE_PARAMS
module-str = params
source "subsys/logging/Kconfig.template.log_config"

config VALUE_PARAMS_INIT_PRIORITY
	int "Driver initialization priority"
	default 95
	help
	  System initialization priority for value parameters drivers.

config VALUE_PARAMS_SETTINGS
	bool "Enable non-volatile parameters support"
	default y
	depends on SETTINGS
	select SETTINGS_INIT
	help
	  Enables support for saving and loading parameter values to/from settings.

config VALUE_PARAMS_SHELL
	bool "Shell command support"
	select FIXED_POINT
	help
	  Enables shell commands to get and set parameters.

endif # VALUE_PARAMS
```

## drivers/value_sync/Kconfig
```kconfig
menuconfig VALUE_SYNC
	bool "Value synchronization driver"
	default y
	depends on DT_HAS_VALUE_SYNC_ENABLED
	help
	  Enable value synchronization support.

if VALUE_SYNC

module = VALUE_SYNC
module-str = sync
source "subsys/logging/Kconfig.template.log_config"

config VALUE_SYNC_INIT_PRIORITY
	int "Driver initialization priority"
	default 95
	help
	  System initialization priority for value synchronization drivers.

config VALUE_SYNC_TIMING
	bool "Enable timing"
	depends on TIMING_FUNCTIONS
	default n
	help
	  Enables time measurement which required for synchronization.

config VALUE_SYNC_SHELL
	bool "Enable shell support"
	default n
	help
	  Enables shell commands for value sync.

endif # VALUE_SYNC
```

## dts/bindings/adc-values.yaml
```yaml
description: |
  ADC values poller.

  Example:

      adc_val0: adc_val {
          compatible = "adc-values";
          #address-cells = <1>;
          #size-cells = <0>;

          adc_val_ch0: channel@0 {
              reg = <0x0>;
              io-channels = <&adc1 2>;
              scale = <(1 << 12)>;
              gain = <1 1>;
              offset = <0 1>;
          };

          adc_val_ch1: channel@1 {
              reg = <0x1>;
              io-channels = <&adc_mux1 3>;
              /* ... */
          };

          /* ... */

          adc_val_ch10: channel@a {
              reg = <0xa>;
              io-channels = <&adc2 0>;
              /* ... */
          };
      };

compatible: adc-values

include:
  - base.yaml
  - value-api.yaml

properties:
  "#address-cells":
    required: false
    const: 1

  "#size-cells":
    required: false
    const: 0

  initial-active:
    type: boolean
    description: Enable polling on initialization.

child-binding:
  description: |
    ADC channels to poll.

  properties:
    reg:
      type: array
      required: true
      description: Channel identifier.

    io-channels:
      type: phandle-array
      description: |
        ADC channel to poll.

        value = raw * gain * scale + bias * scale

        If both vref and sat props is set:

        value = raw * gain * scale * vref / sat + bias * scale

    vref:
      type: array
      description: |
        ADC reference voltage for channel.

        For ex.: 3.3V (3300 1000)

    sat:
      type: int
      description: |
        Saturated ADC value

        Usually it's a maximum value which reached at Vref.

        sat = 2 ^ ADC_res

        So for 12-bit ADC resolution:

        sat = 2 ^ 12 = 4096

    gain:
      type: array
      default: [1, 1]
      description: |
        Raw ADC value gain (<numerator denominator>).

    bias:
      type: array
      default: [0, 1]
      description: |
        Output value offset (<numerator denominator>).

    scale:
      type: int
      description: |
        Output value scale.
```

## dts/bindings/condition-monitor.yaml
```yaml
description: |
  Unified value condition monitor.

  #include <dt-bindings/value/monitor.h>

  / {
    pwr: pwr_graph {
      values = <&mon0 MONITOR_STATE> /*, ... */;
    };

    mon0: cond_mon {
      compatible = "condition-monitor";
      initial-active; /* enable on startup */
      values = <&cpu_t 1>, <&cpu_t 2>; /* monitor two values */
      scale = <(1 << 12)>; /* 12-bit fraction (Q12) */
      minimum = <10>; /* 10C */
      maximum = <75>; /* 75C */
    };
  };

compatible: condition-monitor

include:
  - base.yaml
  - value-api.yaml

properties:
  values:
    type: phandle-array
    required: true
    description: |
      The values for monitoring.

  minimum:
    type: array
    description: |
      Minimum safe value (<numerator denominator>).

      Examples:
        <15> or <15 1> means 15.0
        <15 100> means 0.15

  maximum:
    type: array
    description: |
      Maximum safe value (<numerator denominator>).

      Examples:
        <15> or <15 1> means 15.0
        <15 100> means 0.15

  scale:
    type: int
    default: 1
    description: |
      Monitoring values scale (<demonimator>).

  initial-active:
    type: boolean
    description: |
      Enable monitoring on initialization.
```

## dts/bindings/i2c-config-switch.yaml
```yaml
description: |
  This driver is designed to switch I2C bus target mode on and off
  within power sequencer pipeline via value API.
  I2C bus is switched into target mode (all targets are registered)
  when I2C_CONFIG_SWITCH_ENABLE_TARGET variable is set to non-zero value.
  Otherwise all targets are unregistered, which enables controller mode.
  Target registering/unregistering occur synchronously on value_set call.

compatible: i2c-config-switch

include:
  - value-api.yaml

properties:
  i2c-bus:
    type: phandle
    required: true
    description: I2C bus which needs to be switched.
```

## dts/bindings/i2c-device-configurator.yaml
```yaml
description: |
  Generic device configurator. Its purpose is to push write-data
  to specified I2C device when triggered via value API on positive transition or at init time.

compatible: i2c-device-configurator

include:
  - i2c-device.yaml
  - value-api.yaml

properties:
  initial-state:
    type: int
    description: |
      The state during initialization.

      Operations which associated with that state will be executed during initialization.
    default: 0

child-binding:
  description: State with operations.

  properties:
    state:
      type: int
      description: State identifier.
      required: true

  child-binding:
    description: Operations.

    properties:
      cmd:
        type: array
        description: |
          Optional command code bytes to push before data.

          Actual data will be pushed immediatelly without restart.

      cmd-raw:
        type: uint8-array
        description: |
          Optional command code hex bytes to push before data.

          Actual data will be pushed immediatelly without restart.

      block:
        type: boolean
        description: Add length byte before data.

      data:
        type: array
        description: |
          This array of bytes will be pushed into device upon activation.

      data-raw:
        type: uint8-array
        description: |
          This array of hex bytes will be pushed into device upon activation.
```
