## dts/bindings/power-graph.yaml
```yaml
description: Power graph for gpios and extended regulators

compatible: power-graph

include:
  - base.yaml
  - value-api.yaml

properties:
  safe-state:
    type: int
    required: true
    description: |
      The state which will be used as a safe state.

      This is a safe state to switch in case of errors.

  values:
    type: phandle-array
    required: true
    description: |
      Drivers and value ids to use with power graph.

  value-names:
    type: string-array
    required: true
    description: |
      Names for the provided values. The number of names
      needs to match the number of values.

child-binding:
  description: |
    Power graph states and transitions.

  properties:
    id:
      type: int
      required: false
      description: |
        The numeric identifier of state.

        Usually 0 is an implicit power off state,
        2 is an explicit standby state and so on.

    label:
      type: string
      required: false
      description: |
        The textual name of state or transition.

    initial:
      type: int
      required: false
      description: |
        The identifier of initial state of transition.

    target:
      type: int
      required: false
      description: |
        The identifier of target state of transition.

    stages:
      type: string-array
      required: false
      description: |
        Value binding names to switch for transition.

        Values in this array are sequentially turned on or off
        depending from values in corresponding `states` property.

        Each index should correspond to value binding in parent node
        (see `values` property).

    states:
      type: array
      required: false
      description: |
        Value states to apply under transition.

        Set <1> to turn device on.
        Set <0> to turn device off.

    ignore-faults:
      type: boolean
      description: Go to the next stage when previous failed.
```

## dts/bindings/regulator-extended.yaml
```yaml
description: GPIO-controlled extended regulators

# include: regulator.yaml

# NOTE: The driver supports "regulator-extended-sync" as a specializing
# variant when it's known that the GPIO state change operations are
# isr-ok and not sleep, and both startup and off-on delays are zero.
# This bypasses the asynchronous onoff manager which optimizes both time
# and memory use.
#
# To enable this use both:
#    compatible = "regulator-extended-sync", "regulator-extended";
#

compatible: regulator-extended

include:
  - base.yaml
  - value-api.yaml

properties:
  enable-gpios:
    type: phandle-array
    required: false
    description: |
      GPIO to use to enable/disable the regulator.

      Unlike the gpio property in the Linux bindings this array must
      provide the GPIO polarity and open-drain status in the phandle
      selector.  The Linux enable-active-high and gpio-open-drain
      properties are not valid for Zephyr devicetree files.

  pgood-gpios:
    type: phandle-array
    required: false
    description: |
      GPIO to check power good signal on.

      Unlike the gpio property in the Linux bindings this array must
      provide the GPIO polarity and open-drain status in the phandle
      selector.  The Linux enable-active-high and gpio-open-drain
      properties are not valid for Zephyr devicetree files.

  startup-delay-us:
    type: int
    required: false
    default: 0
    description: Startup time, in microseconds

  off-on-delay-us:
    type: int
    required: false
    default: 0
    description: Off delay time, in microseconds

  regulator-always-on:
    type: boolean
    description: Regulator should always be on

  regulator-boot-on:
    type: boolean
    description: Regulator should be turned on at startup
```

## dts/bindings/value-api.yaml
```yaml
# Include this to add Value API support

properties:
  "#value-cells":
    type: int
    const: 1

  "#up-value-cells":
    type: int
    const: 1

  "#down-value-cells":
    type: int
    const: 1

value-cells:
  # value idendifier
  - value_id

up-value-cells:
  # value idendifier
  - value_id

down-value-cells:
  # value idendifier
  - value_id
```

## dts/bindings/value-calc.yaml
```yaml
description: |
  Unified calculated value provider.

  Provided values can be calculated using another values.

  Config example:
      #include <dt-bindings/value/sync.h>
      #include <dt-bindings/value/calc.h>

      calcs: calcs {
          compatible = "value-calc";
          #value-cells = <1>;

          values = <&adc_vals V_IN_CH>,
                   <&adc_vals I_IN_CH>,
                   <&adc_vals V_OUT_CH>;
          value-names = "V_in", "I_in", "V_out";
          value-scales = <(1 << 24)>, <(1 << 16)>;

          P_in {
              op = "mul";
              arg1-name = "V_in";
              arg2-name = "I_in";
              // export as a value with id: 0
              res-id = <0>;
              res-name = "P_in";
              res-scale = <(1 << 16)>;
          };

          P_out {
              op = "mul";
              arg1-name = "P_in";
              arg2 = <85 100>; /* CoP: 85% */
              arg2-scale = <(1 << 28)>;
              // do not export as a value
              res-name = "P_out";
              res-scale = <(1 << 16)>;
          };

          I_out {
              op = "div";
              arg1-name = "P_out";
              arg2-name = "V_out";
              // export as a value with id: 1
              res-id = <1>;
          };
          /* ...other calcs */
      };

      sync: sync {
          compatible = "value-sync";
          values = <&adc_vals ADC_VALUES_SYNC>,
                   <&calcs CALC_SYNC>;
      };

compatible: value-calc

include:
  - base.yaml
  - value-api.yaml

properties:
  values:
    type: phandle-array
    required: true
    description: |
      Values phandles which can be used as arguments for operations.

  value-names:
    type: string-array
    required: true
    description: |
      The names for values.

      Set this property to be able to use valuea as arguments in operations.

  value-scales:
    type: array
    required: true
    description: |
      The scales for values.

  initial-active:
    type: boolean
    description: |
      Enable driver by default

child-binding:
  description: |
    Calculation operations.

  properties:
    op:
      type: string
      enum:
        - scl
        - neg
        - inv
        - add
        - sub
        - mul
        - div
        - min
        - max
      description: |
        Operation name:

          - scl - Rescale (arg1)
          - neg - Negate (- arg1)
          - inv - Invert (1 / arg1)
          - add - Add (arg1 + arg2)
          - sub - Subtract (arg1 - arg2)
          - mul - Multiply (arg1 * arg2)
          - div - Divide (arg1 / arg2)

    arg1-name:
      type: string
      description: |
        The name of first argument.

        Either `arg1-name` or `arg1-const` must be provided.

    arg1:
      type: array
      description: |
        The value of first argument.

        <value> or <numerator donominator>.

        Either `arg1-name` or `arg1-const` must be provided.

    arg1-scale:
      type: int
      default: 1
      description: |
        The scale of first argument. Required for constant only.

    arg2-name:
      type: string
      description: |
        The name of second argument.

    arg2:
      type: array
      description: |
        The value of second argument.

        <value> or <numerator donominator>.

        Either `arg1-name` or `arg1-const` should be provided.

    arg2-scale:
      type: int
      default: 1
      description: |
        The scale of second argument. Required for constant only.

    res-name:
      type: string
      description: |
        The name of result of current operation.

        If it hasn't assigned then result cannot be used by the subsequent operations.

        Either `res-name` or `res-id` should be provided.

    res-id:
      type: int
      description: |
        Integer identifier of result value.

        If it hasn't assigned then result won't be available for consumers.
        Typically intermediate operations does not need that.

        Either `res-name` or `res-id` should be provided.

    res-scale:
      type: int
      default: 1
      description: |
        The scale (divider) for result value.

        By default scale is equals to 1.
```

## dts/bindings/value-filter.yaml
```yaml
description: |
  Unified value filter driver bindings.

compatible: value-filter

include:
  - base.yaml
  - value-api.yaml

properties:
  values:
    type: phandle-array
    required: true
    description: |
      Input value phandle

  period:
    type: array
    required: true
    description: |
      Time span to discretize parameters (P, seconds)

  alpha:
    type: array
    description: |
      Configure EMA filter using parameter α (weight).
      Smaller α gives smoother result.
      For correct operation α should be less than or equal to 1.

          0 < α <= 1

          y = α * x + (1 - α) * y0

      Either alpha, samples or window should be configured.

  samples:
    type: array
    description: |
      Configure EMA filter using number of samples (n) <numerator denominator>.
      Greater number of samples gives smoother result.
      Samples should be one or more. It also may be fractional.

          α = 2 / (n + 1)

          n > 1 => α < 1

          y = α * x + (1 - α) * y0

      Either alpha, samples or window should be configured.

  window:
    type: array
    description: |
      Configure EMA filter using time window (T, seconds).
      Longer period gives smoother result.
      For correct operation time window (T) should be greater than period (P).

          α = 2 / (T / P + 1)

          T > P => α < 1

          y = α * x + (1 - α) * y0

      Either alpha, samples or window should be configured.

  input-scale:
    type: int
    default: 1
    description: |
      Source value scale.

      The power-of-two values is preferred for fast calculations.

  param-scale:
    type: int
    default: 1
    description: |
      Filter parameter value scale.

      The power-of-two values is preferred for fast calculations.

  output-scale:
    type: int
    default: 1
    description: |
      Result value scale.

      The power-of-two values is preferred for fast calculations.

  output-fract-digits:
    type: int
    default: 3
    description: |
      Number of fraction digits for output values.

      Used by shell commands.

  param-fract-digits:
    type: int
    default: 3
    description: |
      Number of fraction digits for parameter values.

      Used by shell commands.

  units:
    type: string
    description: |
      Human-readable measurement units of input and output value.

      Used by shell commands.

  initial-active:
    type: boolean
    description: Enable filter by defualt
```

## dts/bindings/value-minmax.yaml
```yaml
description: |
  Value min/max driver bindings.

  This driver scans values to determine global minimums and maximums
  while it active.

  Example:
      #include <dt-bindings/value/minmax.h>

      minmax: minmax {
          compatible = "value-minmax";
          #value-cells = <1>;
          values = <&adc_vals CH1>, <&tsen T_CH1> /* ... */;
      };

      /* ... */
      sync: sync {
          compatible = "value-sync";
          values = <&adc_vals VALS_SYNC>, <&tsen TSEN_SYNC>, <&minmax MINMAX_SYNC>;
      };

compatible: value-minmax

include:
  - base.yaml
  - value-api.yaml

properties:
  values:
    type: phandle-array
    required: true
    description: |
      Input values phandles

  initial-active:
    type: boolean
    description: |
      Enable driver by default
```

## dts/bindings/value-mix.yaml
```yaml
description: |
  Unified value mixer.

  Set output value via interpolating input values with runtime configuration.

  Config example:
      #include <dt-bindings/value/sync.h>
      #include <dt-bindings/value/mix.h>

      tmix: tmix {
          compatible = "value-mix";
          #value-cells = <1>;

          values = <&tsen0 TEMP>,
                   <&tsen0 INT_TEMP>,
                   <&tsen1 TEMP>;
          value-names = "t0", "ti0", "t1";

          input-scale = <(1 << 16)>;
          output-scale = <(1 << 16)>;
          weight-scale = <(1 << 24)>;

          // 60% 25% 15%
          weights = <60>, <25>, <15>;
          weight-divider = <100>;
      };

      sync: sync {
          compatible = "value-sync";
          values = <&tsen0 TSEN_SYNC>,
                   <&tsen1 TSEN_SYNC>,
                   <&tmix MIX_SYNC>;
      };

compatible: value-mix

include:
  - base.yaml
  - value-api.yaml

properties:
  values:
    type: phandle-array
    required: true
    description: |
      Values phandles which can be used as inputs.

  value-names:
    type: string-array
    required: true
    description: |
      The names of input value phandles.

  weights:
    type: array
    required: true
    description: |
      Default weight values.

      Each weight corresponds to an input value.

  weight-divider:
    type: int
    default: 1
    description: |
      The denominator value for default weights.

      Set to 100 when your default weights measured in percentages.

  input-scale:
    type: int
    default: 1
    description: |
      The default scale for input values.

      Use either `input-scale` or `input-scales`.

  input-scales:
    type: array
    description: |
      The scales for input values.

      Use either `input-scale` or `input-scales`.

  input-fraction:
    type: int
    default: 3
    description: |
      The number of fraction digits for input values.

      Default value is 3.

  input-units:
    type: string
    default: ""
    description: |
      The name of units for input value.

      Units will be used in shell commands only.

  output-scale:
    type: int
    default: 1
    description: |
      The scale for output value

  output-fraction:
    type: int
    default: 3
    description: |
      The number of fraction digits for output values.

      Default value is 3.

  output-units:
    type: string
    default: ""
    description: |
      The name of units for output value.

      Units will be used in shell commands only.

  weight-scale:
    type: int
    default: 1
    description: |
      The scale for weight values

  weight-fraction:
    type: int
    default: 3
    description: |
      The number of fraction digits for weight values.

      Default value is 3.

  initial-active:
    type: boolean
    description: |
      Enable driver by default
```
